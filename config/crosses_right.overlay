#include <dt-bindings/zmk/keys.h>
#include <input/processors.dtsi>

/ {
    trackball_keybinds: trackball_keybinds {
        compatible = "zettaface,input-processor-keybind";
        #input-processor-cells = <0>;
        mode = <1>;
        bindings = <&kp UP>, <&kp DOWN>, <&kp LEFT>, <&kp RIGHT>;
    };

    trackball_listener {
        raise_arrow_layer {
            layers = <3>; /* SYM layer is now layer 3 */
            input-processors = <&trackball_keybinds>;
        };
    };
};
